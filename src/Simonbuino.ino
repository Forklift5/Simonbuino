/***** SIMONBUINO v2 ****** SIMON (1978 electronic game by Ralph Bauer) clone
- coded by Jerom (April 2015)
- sound FX made with FX Synth by yodasvideoarcade http://gamebuino.com/forum/viewtopic.php?f=17&t=1018 */

#include <SPI.h>//imports the SPI library (needed to communicate with Gamebuino's screen)
#include <Gamebuino.h>//imports the Gamebuino library
Gamebuino gb;//creates a Gamebuino object named gb

//BITMAPS
const byte titleBitmap[] PROGMEM = {64, 30, 0x0, 0x1F, 0xE0, 0x0, 0x79, 0xB1, 0x9E, 0x63, 0x0, 0xFF, 0xFC,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 0x6,};
const byte frameBitmap[] PROGMEM = {64, 48, 0x0, 0x3F, 0xFF, 0xE0, 0x7, 0xFF, 0xFC, 0x0, 0x0, 0x7F, 0xFF,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 0x0,};
const byte buttonMaskBitmap[] PROGMEM = {16, 24, 0x3, 0x0, 0xF, 0x80, 0x1F, 0xC0, 0x3F, 0xC0, 0x7F, 0xE0, 0xFF,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 0x0,};
const byte bottomBitmap[] PROGMEM = {16, 24, 0x1, 0x0, 0xA, 0x80, 0x15, 0x40, 0x2A, 0x80, 0x55, 0x40, 0xAA,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 0x0,};
const byte leftBitmap[] PROGMEM = {16, 24, 0x0, 0x0, 0x0, 0x0, 0x2, 0x0, 0x0, 0x0, 0x8, 0x80, 0x0,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 0x0,};
const byte rightBitmap[] PROGMEM = {16, 24, 0x3, 0x0, 0xA, 0x80, 0x1D, 0xC0, 0x2A, 0x80, 0x77, 0x60, 0xAA,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 0x0,};
const byte topBitmap[] PROGMEM = {16, 24, 0x2, 0x0, 0x0, 0x0, 0xA, 0x80, 0x4, 0x40, 0x2A, 0xA0, 0x0,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 0x0,};
const byte smileySmileBitmap[] PROGMEM = {16, 16, 0x7, 0xE0, 0x1F, 0xF8, 0x3F, 0xFC, 0x7F, 0xFE, 0x67, 0xE6, 0xCB,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 0xE0,};

//SOUND PATTERNS made with FX Synth
const byte soundfx[5][8] = {
  {0, 0, 0, 12, 3, 4, 5, 8}, // sound 0  = up.
  {0, 12, 19, 8, 4, 4, 5, 6}, // sound 1 = right
  {0, 19, 13, 16, 4, 7, 5, 8}, // sound 2 = down.
  {0, 27, 6, 17, 4, 5, 5, 7}, // sound 3 = left.
  {0, 30, 57, 1, 5, 17, 4, 47}, // sound 4 = fail.
};

//GAMES Variables
#define timer_max 16 //delay to play 1 note.
#define NOTESMAX 53 //=== maximum notes stored in the array. !! add 2 to the desired limit.
#define NBNOTES 4 //maximum number of notes available

bool game_start = false;
bool display_top = true;
bool display_right = true;
bool display_bottom = true;
bool display_left = true;
bool game_difficulty = true;
bool melody_playing = true; // only when CPU plays the melody.
bool melody_all = false;//when RECORD acchieved, the melody is played entirely.
bool melody_fail = false;//if right --> reset game.

byte fail_timer = 0;
byte wait_timerstart = 0;
byte wait_timer = 0;
byte sound_play = 0; //which sound
byte melody[NOTESMAX];//size of the array storing the array.
byte melody_currentnote = 0;//
byte melody_step = 1;//increase each time a note is played & the player replicate this right note.
byte melody_timer = 0;
byte delay_timer = 0;

//SETUP
void setup() {
  gb.begin();
  initGame();
}
void initGame() {
  gb.titleScreen(titleBitmap); //gb.titleScreen(F("... a Simon clone."));
  //gb.changeGame();
  gb.pickRandomSeed(); //random notes each reset
  for (byte i = 0; i < (NOTESMAX - 1); i++) {
    melody[i - 1] = random(NBNOTES) + 1;
  }
  //RESET variables
  game_start = false;
  display_top = true;
  display_right = true;
  display_bottom = true;
  display_left = true;
  game_difficulty = true;
  melody_playing = true; // only when CPU plays the melody.
  melody_all = false;//when RECORD acchieved, the melody is played entirely.
  melody_fail = false;//if right --> reset game.
  fail_timer = 0;
  wait_timerstart = 0;
  wait_timer = 0;
  sound_play = 0; //which sound
  melody[NOTESMAX];//size of the array storing the array.
  melody_currentnote = 0;//
  melody_step = 1;//increase each time a note is played & the player replicate this right note.
  melody_timer = 0;
  delay_timer = 0;
}

void loop() {
  if (gb.update()) {
    key_reset();//to cancel at any time;

    //START delay
    if (game_start == false) {
      wait_timerstart ++;
      if (wait_timerstart > timer_max * 1) {
        melody_currentnote = 0; //reinitialize at the start : very important!!
        game_start = true;
      }
    }

    //IF RECORD achieved = hide background + show message + play entire melody!
    if ( melody_step >= (NOTESMAX - 1) ) {
      //endRecord();
      gb.display.setColor(BLACK);
      gb.display.drawBitmap(34, 16, smileySmileBitmap); // draw smiley
      gb.display.cursorX = 0;
      gb.display.cursorY = 0;
      gb.display.print(" CONGRATULATIONS!!\n \    \27 to reset");
      if (melody_all == false) melody_all == true; //play the whole string of notes?
    }
    else
    {
      //BACKGROUND
      gb.display.setColor(BLACK);
      gb.display.drawBitmap(10, 0, frameBitmap);
      //PLAYING TURNS
      if ((delay_timer == 0) && (game_start == true)) {
        if (melody_playing == true) {
          melodyPlaying();
        } else playerPlaying();
      }
      //delay after the player turn
      if (delay_timer > 0) {
        delay_timer ++;
        if (delay_timer > timer_max >> 1) delay_timer = 0;
      }
      //DRAW
      drawButtons();
    }//end record
  }//end update.
}//end loop.
